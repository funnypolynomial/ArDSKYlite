#include <Arduino.h>
#include <avr/pgmspace.h>
#include "RTC.h"
#include "Config.h"
#include "Graphics.h"
#include "Moon.h"

int Time::DaysInMonth(int Month, int Year)  // 1..12, 2001..2099
{
  // (Days-28) encoded as 2bits/Month 0b0000DD..FFJJ00
  int Increment = (0x03BBEECCUL >> (2*Month) & 0x03);
  if ((Year % 4) || Increment)    // (simple leap year test)
    return 28 + Increment;
  else
    return 29;  // Leap year AND Feb
}

long Time::DayOfCentury(int Date,  // 1..31
                        int Month, // 1..12
                        int Year)  // 2001..2099 (Leap year test is basic)
{
  // years into the "century"
  Year -= 2000;
  // days in whole years
  long Day = Date + 365L*Year;
  // leap days (except in 2000)
  Day += (Year - 1)/4L;

  // days in this year
  while (--Month > 0) 
    Day += DaysInMonth(Month, Year);
  return Day;
}

unsigned long Time::MakeSeconds(int Date, int Month, int Year, int Hour, int Minute)
{
  // mktime-like thing, seconds since 1/1/2000 00:00
  unsigned long Minutes = DayOfCentury(Date, Month, Year)*24UL*60UL;
  Minutes += Hour*60UL + Minute;
  return Minutes*60UL;
}

extern long rcosx(long r, long x)
{
  x = 90 - x;
  if (x < 0) 
  {
    x += 180;
    r = -r;
  }
  if (x > 180)
  {
    x -= 180;
    r = -r;
  }
  // Bhaskara I's sine approximation:
  return r*4L*x*(180L-x)/(40500L - x*(180L-x));
}

void Moon::CalcAge(//unsigned long referenceNewMoonSeconds, int Day, int Month, int Year, int Hour, int Minute,   // SAVE program space!
                   int& AgeDays, int& Angle, int& DaysUntilPlus1)
{
  unsigned long referenceNewMoonSeconds = Config::_RefNewMoonSeconds; 
 
  // DaysUntilPlus1 is +ve if until Full, else until new
  const unsigned long moonPeriodSeconds = 2551443UL;  // ~29.530587981 days
  const unsigned long dayLengthSeconds = 24UL*60UL*60UL;
  unsigned long CalcMoonSeconds = Time::MakeSeconds(rtc.m_DayOfMonth, rtc.m_Month, rtc.m_Year + 2000, rtc.m_Hour24, rtc.m_Minute);
  unsigned long diffSeconds = CalcMoonSeconds - referenceNewMoonSeconds;
  if (CalcMoonSeconds < referenceNewMoonSeconds)
    diffSeconds = moonPeriodSeconds - (referenceNewMoonSeconds - CalcMoonSeconds);
  unsigned long AgeSeconds = diffSeconds % moonPeriodSeconds;
  AgeDays = AgeSeconds/dayLengthSeconds;
  Angle = AgeSeconds*180UL/moonPeriodSeconds;
  
  // Calc days to next Full etc, this can be out by quite a lot since the Full may not be half-way between New's
  if (Angle < 90)
  {
    DaysUntilPlus1 = (moonPeriodSeconds/2UL - AgeSeconds)/dayLengthSeconds;
    if (((moonPeriodSeconds/2UL - AgeSeconds) % dayLengthSeconds) > dayLengthSeconds/2UL)
      DaysUntilPlus1++; // round up
    DaysUntilPlus1++;
  }
  else
  {
    DaysUntilPlus1 = (moonPeriodSeconds - AgeSeconds)/dayLengthSeconds;
    if (((moonPeriodSeconds - AgeSeconds)/dayLengthSeconds) > dayLengthSeconds/2UL)
      DaysUntilPlus1++; // round up
    DaysUntilPlus1++;
    DaysUntilPlus1 = -DaysUntilPlus1;
  }
}

#define MOON_IMAGE_WIDTH  155
#define MOON_IMAGE_HEIGHT 152
// just so we can push all that data out of the way at the bottom of the file
const byte* GetMoonRows();

void Moon::CreatePalette(word* palette)
{
  // just shades of grey
  for (int pal = 0; pal < 16; pal++)
  {
    byte val = pal*16;
    if (val == 0) val = 8;
    palette[pal] = RGB(val,val,val);
  }
}

void Moon::DrawPhase(int phaseAngle)
{
  word palette[16];
  CreatePalette(palette);
  if (Config::_OutputFlags & Config::MaskNorthern)  // Northern hemisphere
  {
    if (phaseAngle <= 90)
      DrawGore(180 - phaseAngle*2, 180, palette, true);
    else
      DrawGore(0, 180 - (90 - phaseAngle)*2, palette, true);
  }
  else  // Southern
  {
    if (phaseAngle <= 90)
      DrawGore(0, phaseAngle*2, palette, true);
    else
      DrawGore((90 - phaseAngle)*2, 180, palette, true);
  }
}

#define SITE_SIZE 4
void Moon::DrawLandingSite()
{  
  lcd.beginFill((LCD_WIDTH - MOON_IMAGE_WIDTH)/2 + 115, (LCD_HEIGHT - MOON_IMAGE_HEIGHT)/2 + 77, SITE_SIZE, SITE_SIZE); 
  lcd.fillColour(SITE_SIZE*SITE_SIZE, 0xF800);
}

#ifdef USE_MOON_GRAPHICS
void Moon::DrawGore(int startAngle, int endAngle, word* palette, bool wax)
{
  // draws a "gore" of the moon image, a strip of pixels between the two meridian angles, 0 starting from the LEFT
  // if wax, uses the given palette, otherwise black
  // Note the original plan was to *shade* the moon image by darkening the palette based on the angle around the sphere.
  // Unfortunately very dark, almost black, colours have a greenish tinge, so that was abandoned.
  lcd.setWindow(0, 0, LCD_WIDTH, LCD_HEIGHT);
  
  const byte* ptr = GetMoonRows();
  int left = (LCD_WIDTH - MOON_IMAGE_WIDTH)/2;
  int top = (LCD_HEIGHT - MOON_IMAGE_HEIGHT)/2;
  byte startEdges[MOON_IMAGE_WIDTH];
  byte endEdges[MOON_IMAGE_WIDTH];
  // pre-build the trig calculations so they don't happen while we're drawing, a delay before we start is better than while painting a strip
  for (int i = 0; i <=  MOON_IMAGE_WIDTH/2; i++)
  {
    startEdges[i] = i + rcosx(i, startAngle);
    endEdges[i] = i + rcosx(i, endAngle);
  }

  // the data is list of rows with # black pixels first then two-pixels per byte image detail
  // we need to skip over data up to the point we start drawing, draw the pixels then skip the rest of the row
  // to arrive at the start of the next
  for (int row = 0; row < MOON_IMAGE_HEIGHT; row++)
  {
    int blackCols = pgm_read_byte(ptr++);
    int colourCols = MOON_IMAGE_WIDTH - 2*blackCols;
    int startEdge = startEdges[colourCols/2];
    int endEdge = endEdges[colourCols/2];
    lcd.setPosition(left + blackCols + colourCols - startEdge, top + row, startEdge - endEdge + 1, 1);
    // skip whole leadng bytes
    while ((colourCols - startEdge) > 2)
    {
      ptr++;
      colourCols -= 2;
    }
    while (colourCols > 0)
    {
      byte pair = pgm_read_byte(ptr++);
      for (int pix = 0; pix < 2; pix++)
      {
        if (colourCols-- > 0)
        {
           if (colourCols >= endEdge)
           {
             word colour = wax?palette[pair & 0x0F]:0x0000;
             FastData(colour >> 8);
             FastData(colour & 0xFF);
             SERIALISE_FILLCOLOUR(1, colour);
           }
           else if (colourCols < endEdge)
           {
             // past the last pixel, skip the remaining bytes
             while (colourCols > 0)
             {
               ptr++;
               colourCols -= 2;
             }
             pix = 2;
           }
        }
        pair >>= 4;
      }
    }
  }
}

static const byte pMoonImageRows[] PROGMEM =
{
  // number of black pixels at row start, colour pixels (two per byte, grey scale, 0xRL)...
  0x40,                                                                                                                                                                                                                                                                   0x00, 0x00, 0x10, 0x87, 0x78, 0x67, 0x66, 0x66, 0x77, 0x88, 0x17, 0x00, 0x00, 0x00,
  0x3C,                                                                                                                                                                                                                                                   0x10, 0x11, 0x43, 0x44, 0x44, 0x55, 0x55, 0x55, 0x55, 0x55, 0x55, 0x55, 0x45, 0x44, 0x44, 0x12, 0x11, 0x00,
  0x39,                                                                                                                                                                                                                                       0x21, 0x22, 0x44, 0x55, 0x55, 0x55, 0x65, 0x66, 0x66, 0x55, 0x55, 0x65, 0x66, 0x66, 0x66, 0x66, 0x55, 0x44, 0x24, 0x11, 0x00,
  0x34,                                                                                                                                                                                                                   0x00, 0x31, 0x53, 0x55, 0x55, 0x55, 0x55, 0x55, 0x55, 0x76, 0x67, 0x56, 0x65, 0x77, 0x77, 0x77, 0x77, 0x67, 0x55, 0x66, 0x56, 0x45, 0x34, 0x22, 0x00, 0x00,
  0x32,                                                                                                                                                                                                           0x10, 0x42, 0x54, 0x55, 0x56, 0x55, 0x55, 0x65, 0x66, 0x66, 0x66, 0x78, 0x66, 0x86, 0x88, 0x88, 0x78, 0x77, 0x67, 0x55, 0x55, 0x55, 0x45, 0x44, 0x44, 0x33, 0x11, 0x00,
  0x30,                                                                                                                                                                                                   0x21, 0x43, 0x55, 0x66, 0x55, 0x56, 0x65, 0x66, 0x66, 0x66, 0x66, 0x66, 0x77, 0x77, 0x77, 0x87, 0x88, 0x78, 0x77, 0x67, 0x66, 0x66, 0x55, 0x55, 0x55, 0x45, 0x44, 0x33, 0x12, 0x00,
  0x2D,                                                                                                                                                                                       0x10, 0x53, 0x65, 0x66, 0x76, 0x66, 0x66, 0x66, 0x66, 0x77, 0x77, 0x77, 0x77, 0x77, 0x77, 0x77, 0x77, 0x97, 0x99, 0x77, 0x77, 0x77, 0x66, 0x66, 0x66, 0x56, 0x55, 0x55, 0x45, 0x44, 0x24, 0x12, 0x00,
  0x2B,                                                                                                                                                                               0x10, 0x43, 0x65, 0x66, 0x76, 0x77, 0x77, 0x77, 0x77, 0x77, 0x77, 0x77, 0x87,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 0x00,
  0x29,                                                                                                                                                                       0x10, 0x43, 0x65, 0x66, 0x77, 0x77, 0x88, 0x78, 0x77, 0x77, 0x87, 0x88, 0x88,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 0x00,
  0x27,                                                                                                                                                               0x10, 0x53, 0x65, 0x66, 0x77, 0x87, 0x88, 0x99, 0x88, 0x88, 0x77, 0x77, 0x76,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 0x00,
  0x25,                                                                                                                                                       0x10, 0x43, 0x65, 0x76, 0x77, 0x88, 0x88, 0x88, 0x88, 0x88, 0x88, 0x56, 0x55,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 0x00,
  0x24,                                                                                                                                                   0x20, 0x44, 0x65, 0x77, 0x87, 0x78, 0x87, 0x88, 0x88, 0x88, 0x88, 0x88, 0x88,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 0x00,
  0x22,                                                                                                                                           0x10, 0x43, 0x34, 0x76, 0x87, 0x78, 0x77, 0x77, 0x46, 0x44, 0x44, 0x64, 0x97,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 0x00,
  0x21,                                                                                                                                       0x20, 0x43, 0x33, 0x75, 0x88, 0x88, 0x77, 0x56, 0x44, 0x44, 0x44, 0x44, 0x64,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 0x01,
  0x20,                                                                                                                                   0x31, 0x33, 0x33, 0x53, 0x77, 0x77, 0x57, 0x44, 0x44, 0x44, 0x44, 0x65, 0x98,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 0x01,
  0x1E,                                                                                                                           0x20, 0x33, 0x33, 0x33, 0x43, 0x55, 0x44, 0x44, 0x44, 0x44, 0x54, 0x86, 0xAA,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 0x01,
  0x1D,                                                                                                                       0x30, 0x34, 0x33, 0x33, 0x33, 0x43, 0x44, 0x44, 0x44, 0x44, 0x75, 0x98, 0xAA,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 0x01,
  0x1B,                                                                                                               0x10, 0x33, 0x33, 0x33, 0x33, 0x43, 0x44, 0x44, 0x44, 0x44, 0x64, 0xA9, 0xBA,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 0x00,
  0x1A,                                                                                                           0x20, 0x33, 0x33, 0x33, 0x33, 0x44, 0x44, 0x54, 0x66, 0x65, 0x76, 0xAA, 0xBB,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 0x00,
  0x19,                                                                                                       0x20, 0x33, 0x33, 0x33, 0x43, 0x44, 0x44, 0x44, 0x97, 0x99, 0xA9, 0xBA, 0xBB,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 0x00,
  0x18,                                                                                                   0x20, 0x33, 0x33, 0x33, 0x43, 0x44, 0x44, 0x44, 0x95, 0xAA, 0xAA, 0xBB, 0xBB,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 0x00,
  0x17,                                                                                               0x20, 0x33, 0x33, 0x33, 0x43, 0x44, 0x44, 0x44, 0x74, 0xAA, 0xBA, 0xBB, 0xBB,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 0x00,
  0x16,                                                                                           0x20, 0x44, 0x34, 0x33, 0x44, 0x44, 0x44, 0x44, 0x55, 0xA7, 0xBB, 0xBB, 0xBB,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 0x00,
  0x15,                                                                                       0x20, 0x54, 0x34, 0x33, 0x44, 0x44, 0x44, 0x54, 0x55, 0x96, 0xBB, 0xBB, 0xBB,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 0x00,
  0x14,                                                                                   0x20, 0x54, 0x34, 0x43, 0x44, 0x44, 0x44, 0x55, 0x55, 0x95, 0xBB, 0xBB, 0xBB,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 0x00,
  0x13,                                                                               0x20, 0x54, 0x34, 0x33, 0x44, 0x44, 0x44, 0x55, 0x55, 0x65, 0xBB, 0xBB, 0xBB,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 0x00,
  0x12,                                                                           0x20, 0x34, 0x34, 0x33, 0x44, 0x44, 0x44, 0x55, 0x55, 0x55, 0xB8, 0xBB, 0xBB,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 0x00,
  0x11,                                                                       0x20, 0x34, 0x33, 0x43, 0x44, 0x44, 0x54, 0x55, 0x55, 0x55, 0x96, 0xBB, 0xCB,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 0x00,
  0x10,                                                                   0x20, 0x34, 0x33, 0x33, 0x44, 0x44, 0x54, 0x55, 0x55, 0x76, 0x76, 0xBB, 0xCB,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 0x00,
  0x10,                                                                   0x41, 0x33, 0x33, 0x43, 0x44, 0x44, 0x55, 0x55, 0x55, 0x87, 0x96, 0xBB, 0xCC,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 0x01,
  0x0F,                                                               0x31, 0x44, 0x33, 0x44, 0x44, 0x54, 0x55, 0x55, 0x55, 0x76, 0x67, 0xB8, 0x9B,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 0x01,
  0x0E,                                                           0x30, 0x43, 0x33, 0x43, 0x44, 0x54, 0x55, 0x55, 0x55, 0x65, 0x78, 0x66, 0x78,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 0x00,
  0x0E,                                                           0x31, 0x33, 0x33, 0x44, 0x44, 0x55, 0x55, 0x55, 0x65, 0x76, 0x79, 0x66, 0x66,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 0x02,
  0x0C,                                                   0x10, 0x32, 0x33, 0x43, 0x44, 0x54, 0x55, 0x65, 0x66, 0x77, 0x98,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 0x00,
  0x0C,                                                   0x30, 0x33, 0x33, 0x44, 0x44, 0x55, 0x65, 0x87, 0x88, 0x99, 0x99,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 0x01,
  0x0B,                                               0x20, 0x34, 0x33, 0x43, 0x44, 0x54, 0x55, 0x86, 0x88, 0x98, 0x99,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 0x00,
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  0x0D,                                                       0x20, 0x54, 0x55, 0x65, 0x66, 0x76, 0x88, 0x88, 0x99, 0x99, 0x79,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 0x00,
  0x0E,                                                           0x30, 0x54, 0x55, 0x66, 0x55, 0x77, 0x88, 0x88, 0x99, 0x99, 0x77, 0x66, 0x86,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 0x00,
  0x0F,                                                               0x31, 0x55, 0x55, 0x56, 0x54, 0x77, 0x88, 0x88, 0x99, 0x89, 0x89, 0x66, 0xA8,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 0x01,
  0x0F,                                                               0x20, 0x54, 0x55, 0x55, 0x65, 0x76, 0x87, 0x88, 0x98, 0x99, 0x99, 0x68, 0x97,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 0x00,
  0x10,                                                                   0x20, 0x54, 0x55, 0x65, 0x66, 0x77, 0x87, 0x88, 0x98, 0xAA, 0xAA, 0x88, 0xAA,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 0x00,
  0x11,                                                                       0x20, 0x54, 0x55, 0x65, 0x77, 0x77, 0x87, 0x88, 0xA9, 0xBB, 0xBB, 0xBB, 0xBB,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 0x00,
  0x12,                                                                           0x20, 0x54, 0x65, 0x76, 0x67, 0x77, 0x77, 0x87, 0xA9, 0xBA, 0xBB, 0xBB, 0xBB,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 0x00,
  0x13,                                                                               0x20, 0x55, 0x65, 0x66, 0x66, 0x46, 0x54, 0x87, 0x99, 0xA9, 0xBA, 0xBB, 0xBB,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 0x00,
  0x14,                                                                                   0x40, 0x55, 0x65, 0x65, 0x66, 0x34, 0x64, 0x88, 0x88, 0x99, 0xBA, 0xBB, 0xBB,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 0x00,
  0x15,                                                                                       0x31, 0x55, 0x55, 0x65, 0x66, 0x66, 0x77, 0x87, 0x88, 0x98, 0xBA, 0xBB, 0xBB,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 0x01,
  0x15,                                                                                       0x10, 0x53, 0x55, 0x55, 0x66, 0x76, 0x77, 0x75, 0x88, 0x88, 0xA9, 0xBB, 0xBB,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 0x00,
  0x16,                                                                                           0x10, 0x43, 0x55, 0x55, 0x66, 0x76, 0x57, 0x86, 0x88, 0x88, 0xA9, 0xBB, 0xBB,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 0x00,
  0x18,                                                                                                   0x20, 0x54, 0x65, 0x65, 0x66, 0x66, 0x77, 0x87, 0x88, 0x98, 0xBA, 0xBB, 0xBB,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 0x00,
  0x19,                                                                                                       0x20, 0x54, 0x65, 0x55, 0x66, 0x76, 0x77, 0x77, 0x88, 0xA8, 0xAA, 0xBB, 0xBB,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 0x00,
  0x1A,                                                                                                           0x20, 0x54, 0x65, 0x56, 0x66, 0x76, 0x87, 0x88, 0x88, 0xA9, 0xAA, 0xBA, 0xBB,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 0x00,
  0x1B,                                                                                                               0x20, 0x44, 0x55, 0x55, 0x75, 0x87, 0x88, 0x88, 0x87, 0xA9, 0xAA, 0xAA, 0xBA,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 0x00,
  0x1C,                                                                                                                   0x10, 0x43, 0x55, 0x55, 0x76, 0x77, 0x88, 0x78, 0x87, 0x99, 0xAA, 0xAA, 0xAA,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 0x00,
  0x1E,                                                                                                                           0x31, 0x54, 0x55, 0x66, 0x77, 0x87, 0x78, 0x77, 0x98, 0x99, 0x99, 0x99, 0xAA,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 0x01,
  0x1F,                                                                                                                               0x10, 0x43, 0x55, 0x66, 0x76, 0x77, 0x88, 0x77, 0x77, 0x87, 0x88, 0xA9, 0xAA,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 0x00,
  0x21,                                                                                                                                       0x31, 0x54, 0x55, 0x66, 0x76, 0x88, 0x78, 0x77, 0x77, 0x87, 0x99, 0xA9, 0xAA,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 0x01,
  0x21,                                                                                                                                       0x00, 0x42, 0x55, 0x65, 0x66, 0x87, 0x88, 0x88, 0x78, 0x87, 0x99, 0x99, 0xA9,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 0x00,
  0x24,                                                                                                                                                   0x21, 0x54, 0x55, 0x66, 0x86, 0x88, 0x88, 0x88, 0x88, 0x99, 0x99, 0xA9, 0xAA,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 0x01,
  0x25,                                                                                                                                                       0x10, 0x53, 0x55, 0x65, 0x77, 0x88, 0x98, 0x88, 0x88, 0x88, 0x99, 0xAA, 0x99,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 0x00,
  0x27,                                                                                                                                                               0x20, 0x54, 0x65, 0x76, 0x77, 0x88, 0x78, 0x77, 0x88, 0x98, 0x99, 0x99, 0x99,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 0x00,
  0x29,                                                                                                                                                                       0x20, 0x54, 0x66, 0x66, 0x77, 0x77, 0x77, 0x77, 0x88, 0x88, 0x88, 0x88, 0x98,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 0x00,
  0x2A,                                                                                                                                                                           0x10, 0x42, 0x54, 0x66, 0x76, 0x77, 0x67, 0x77, 0x77, 0x77, 0x88, 0x88, 0x98,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 0x00,
  0x2C,                                                                                                                                                                                   0x00, 0x31, 0x55, 0x66, 0x66, 0x67, 0x66, 0x77, 0x77, 0x77, 0x87, 0x99, 0x99,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 0x00,
  0x2F,                                                                                                                                                                                               0x10, 0x32, 0x55, 0x66, 0x66, 0x76, 0x77, 0x77, 0x77, 0x88, 0x88, 0x88, 0x88, 0x99, 0x78, 0x77, 0x98, 0x89, 0x88, 0x88, 0x88, 0x88, 0x78, 0x77, 0x67, 0x56, 0x55, 0x56, 0x34, 0x12, 0x00,
  0x32,                                                                                                                                                                                                           0x10, 0x43, 0x54, 0x66, 0x66, 0x66, 0x77, 0x77, 0x77, 0x87, 0x88, 0x88, 0x88, 0x78, 0x77, 0x88, 0x88, 0x88, 0x77, 0x77, 0x77, 0x67, 0x66, 0x66, 0x55, 0x44, 0x12, 0x00,
  0x34,                                                                                                                                                                                                                   0x00, 0x31, 0x53, 0x55, 0x66, 0x66, 0x66, 0x76, 0x77, 0x77, 0x77, 0x77, 0x77, 0x77, 0x77, 0x77, 0x77, 0x77, 0x66, 0x66, 0x66, 0x56, 0x55, 0x33, 0x01, 0x00,
  0x38,                                                                                                                                                                                                                                   0x10, 0x22, 0x44, 0x54, 0x65, 0x66, 0x66, 0x66, 0x66, 0x66, 0x66, 0x66, 0x66, 0x66, 0x66, 0x66, 0x56, 0x55, 0x44, 0x24, 0x12, 0x00,
  0x3C,                                                                                                                                                                                                                                                   0x10, 0x11, 0x43, 0x44, 0x44, 0x55, 0x55, 0x55, 0x55, 0x55, 0x55, 0x55, 0x45, 0x44, 0x44, 0x13, 0x11, 0x00,
  0x40,                                                                                                                                                                                                                                                                   0x00, 0x00, 0x10, 0x76, 0x66, 0x55, 0x55, 0x55, 0x65, 0x76, 0x16, 0x00, 0x00, 0x00,
}; // 9594 bytes, ~9k
const byte* GetMoonRows()
{
  return pMoonImageRows;
}
#else
void Moon::DrawGore(int startAngle, int endAngle, word* , bool wax)
{
  // draws a "gore" of the moon image, a strip of pixels between the two meridian angles, 0 starting from the LEFT
  // if wax, uses the given palette, otherwise black
  // SIMPLIFIED LESS DETAIL version of the one above, just trig, black and white
  lcd.setWindow(0, 0, LCD_WIDTH, LCD_HEIGHT);
  
  int left = (LCD_WIDTH - MOON_IMAGE_WIDTH)/2;
  int top = (LCD_HEIGHT - MOON_IMAGE_HEIGHT)/2;
  byte startEdges[MOON_IMAGE_WIDTH];
  byte endEdges[MOON_IMAGE_WIDTH];
  int imageDiameter = MOON_IMAGE_WIDTH;
  
  // pre-build the trig calculations so they don't happen while we're drawing, a delay before we start is better than while painting a strip
  for (int i = 0; i <=  imageDiameter/2; i++)
  {
    startEdges[i] = i + rcosx(i, startAngle);
    endEdges[i] = i + rcosx(i, endAngle);
  }
  
  for (int row = 0; row < imageDiameter; row++)
  {
    int dY = abs(row - imageDiameter/2);
    int blackCols = imageDiameter/2 - sqrt(imageDiameter*imageDiameter/4 - dY*dY);
    int colourCols = imageDiameter - 2*blackCols;
    int startEdge = startEdges[colourCols/2];
    int endEdge = endEdges[colourCols/2];
    lcd.setPosition(left + blackCols + colourCols - startEdge, top + row, startEdge - endEdge + 1, 1);
    byte colour = wax?0xFF:0x00;
    lcd.fillByte(startEdge - endEdge + 1, colour);
  }
}
#endif
